## Documentation/devicetree/bindings/gpio/gpio-camio.txt
```
Critical Link CameraIO GPIO controller bindings

Required properties:
- compatible:
  - "cl,camio-1.0"
- reg: Physical base address and length of the controller's registers.
- #gpio-cells : Should be two.
  - first cell is the pin number
  - second cell is used to specify optional parameters (unused)
- gpio-controller : Marks the device node as a GPIO controller.
- #interrupt-cells : Should be 1.
- interrupts: Specify the interrupt.
- interrupt-controller: Mark the device node as an interrupt controller
  The first cell is the GPIO number.

Note: If the CameraIO GPIO is set to be built as a module, peripherals that uses
CameraIO GPIO as interrupt-parent should be a module so that the peripheral
doesn't get initialized before CameraIO GPIO is initialized.

Example:

gpio_altr: gpio_altr {
    compatible = "altr,pio-1.0";
    reg = <0xff200000 0x10>;
    interrupts = <0 45 4>;
    #gpio-cells = <2>;
    gpio-controller;
    #interrupt-cells = <1>;
    interrupt-controller;
};
```

## Documentation/devicetree/bindings/i2c/i2c-cl.txt
```
* I2C driver for Critical Link SOC FPGA SPI Controller

Required properties:
- compatible : Should be "cl,i2c-1.0".
- reg : Contains one entry, which is a tuple consisting of a
	physical address and length.  The entry is the address and
	length of the controller register set.
- interrupts : Unit interrupt specifier for the controller interrupt.
- master-ref-clk : Specifies the frequency of the controller input clock.
- clk-frequency : The requested frequency of SCL

Example:

		i2c5: i2c@ff230000 {
			#address-cells = <1>;
			#size-cells = <0>;
			compatible = "cl,i2c-1.0";
			reg = <0xff230000 0x1000>;
			interrupts = <0 159 4>;
			status = "okay";

			clk-frequency = <100000>;
			master-ref-clk = <50000000>;
		};
```

## Documentation/devicetree/bindings/input/touchscreen/tsc2046.txt
```
* Texas Instruments tsc2046 touchscreen FPGA controller

Required properties:
- compatible: must be "cl,tsc2046".
- reg: Address of FPGA core
- interrupts: interrupt for touch event
Optional properties:
- cl,swap-xy: swap x and y
- cl,reverse-x: Invert x axis
- cl,reverse-y: Invert y axis

Example:

tsc2046: touchscreen0x0180 {
	compatible = "cl,tsc2046";
	reg = <0x180 0x20>;
	interrupts = <0 45 4>;
	cl,swap-xy;
	cl,reverse-x;
};
```

## Documentation/devicetree/bindings/net/stmmac-mdio.txt
```
* STMicroelectronics 10/100/1000 Ethernet driver (GMAC) - MDIO interface

Required properties:
- compatible: Should be "st,stmmac-mdio"
- reg: Address and length of the register set for the device
- phy-mode: phy nodes
- mii_address: offset of MII address register
- mii_data: offset of MII data register
- mac-handle = Handle of MAC to use to access this MDIO bus (not implemented... uses reg property)

Examples:

mdio0: mdio@ff700000 {                                                                                          
	compatible = "stmmac,stmmac-mdio";
	reg = <0xff700000 0x20>;
	mii_address = <0x14>;
	mii_data = <0x18>;
	mac-handle = <&gmac0>;
	status = "disabled";

	/* add phy nodes in board file */
};
```

## Documentation/devicetree/bindings/pci/altera-pcie.txt
```
* Altera PCIe controller

Required properties:
- compatible : should contain "altr,pcie-root-port-1.0"
- reg: A list of physical base address and length for TXS and CRA.
- reg-names: Must include the following entries:
  "Txs": TXS region
  "Cra": Cra registers
-interrupts: specifies the interrupt source of the parent interrupt
     controller. The format of the interrupt specifier depends on the
     parent interrupt controller.
- device_type: must be "pci"

Optional properties:
- altr,msi = phandle to the MSI component

Example
	pcie_0: pcie@0x0 {
		compatible = "altr,pcie-root-port-1.0";
		reg = < 0xc0000000 0x20000000
			0xFF240000 0x00004000  >;
		reg-names = “Txs”, “Cra”;
		interrupt-parent = < &hps_0_arm_gic_0 >;
		interrupts = < 0 43 4 >;
		interrupt-controller;
		#interrupt-cells = < 1 >;
		altr,msi = <&msi_0>;
		device_type = "pci";
	};
```

## Documentation/devicetree/bindings/spi/spi-cl.txt
```
* SPI driver for Critical Link SOC FPGA SPI Controller

Required properties:
- compatible : Should be "cl,spi-1.0".
- reg : Contains one entry, which is a tuple consisting of a
	physical address and length.  The entry is the address and
	length of the controller register set.
- interrupts : Unit interrupt specifier for the controller interrupt.
- master-ref-clk : Specifies the frequency of the controller input clock.
- num-chipselect : Number of chip select lines.
- bus-num : Number of the SPI bus to which the controller is connected.

Example:

	clspi: spi@ff210000 {
		compatible = "cl,spi-1.0";
		#address-cells = <1>;
		#size-cells = <0>;
		reg = <0xff210000 0x0100>,
		interrupts = <0 40 4>;
		master-ref-clk = <750000000>;
		num-chipselect = <8>;
		bus-num = <3>;
	}
```

## arch/arm/configs/mitysom5csx_tiger_defconfig
```kconfig
CONFIG_SYSVIPC=y
CONFIG_HIGH_RES_TIMERS=y
CONFIG_IKCONFIG=y
CONFIG_IKCONFIG_PROC=y
CONFIG_LOG_BUF_SHIFT=14
CONFIG_CGROUPS=y
CONFIG_CPUSETS=y
CONFIG_NAMESPACES=y
CONFIG_BLK_DEV_INITRD=y
CONFIG_RD_LZMA=y
CONFIG_RD_XZ=y
CONFIG_EMBEDDED=y
CONFIG_PROFILING=y
CONFIG_OPROFILE=y
CONFIG_MODULES=y
CONFIG_MODULE_UNLOAD=y
# CONFIG_LBDAF is not set
# CONFIG_BLK_DEV_BSG is not set
# CONFIG_IOSCHED_DEADLINE is not set
# CONFIG_IOSCHED_CFQ is not set
CONFIG_ARCH_SOCFPGA=y
CONFIG_ARM_THUMBEE=y
CONFIG_PL310_ERRATA_753970=y
CONFIG_SMP=y
CONFIG_VMSPLIT_2G=y
CONFIG_NR_CPUS=2
CONFIG_AEABI=y
CONFIG_OABI_COMPAT=y
CONFIG_HIGHMEM=y
CONFIG_HIGHPTE=y
CONFIG_ZBOOT_ROM_TEXT=0x0
CONFIG_ZBOOT_ROM_BSS=0x0
CONFIG_VFP=y
CONFIG_NEON=y
CONFIG_NET=y
CONFIG_PACKET=y
CONFIG_UNIX=y
CONFIG_NET_KEY=y
CONFIG_NET_KEY_MIGRATE=y
CONFIG_INET=y
CONFIG_IP_MULTICAST=y
CONFIG_IP_PNP=y
CONFIG_IP_PNP_DHCP=y
CONFIG_IP_PNP_BOOTP=y
CONFIG_IP_PNP_RARP=y
CONFIG_VLAN_8021Q=y
CONFIG_VLAN_8021Q_GVRP=y
CONFIG_CAN=y
CONFIG_CAN_C_CAN=y
CONFIG_CAN_C_CAN_PLATFORM=y
CONFIG_CAN_DEBUG_DEVICES=y
CONFIG_DEVTMPFS=y
CONFIG_DEVTMPFS_MOUNT=y
CONFIG_MTD=y
CONFIG_MTD_BLOCK=y
CONFIG_MTD_M25P80=y
CONFIG_MTD_NAND=y
CONFIG_MTD_NAND_DENALI=y
CONFIG_MTD_NAND_DENALI_DT=y
CONFIG_MTD_SPI_NOR=y
CONFIG_BLK_DEV_RAM=y
CONFIG_BLK_DEV_RAM_COUNT=2
CONFIG_BLK_DEV_RAM_SIZE=8192
CONFIG_ALTERA_SYSID=y
CONFIG_EEPROM_AT24=y
CONFIG_ALTERA_STAPL=y
CONFIG_FPGA_BRIDGE=y
CONFIG_ALTERA_SOCFPGA_BRIDGE=y
CONFIG_SCSI=y
# CONFIG_SCSI_PROC_FS is not set
CONFIG_BLK_DEV_SD=y
# CONFIG_SCSI_LOWLEVEL is not set
CONFIG_FPGA=y
CONFIG_FPGA_MGR_ALTERA=y
CONFIG_NETDEVICES=y
CONFIG_STMMAC_ETH=y
CONFIG_DWMAC_SOCFPGA=y
CONFIG_STMMAC_DEBUG_FS=y
CONFIG_MICREL_PHY=y
CONFIG_INPUT_EVDEV=y
CONFIG_KEYBOARD_GPIO=y
CONFIG_KEYBOARD_GPIO_POLLED=y
CONFIG_INPUT_TOUCHSCREEN=y
CONFIG_TOUCHSCREEN_TSC2046=y
# CONFIG_SERIO_SERPORT is not set
CONFIG_SERIO_AMBAKMI=y
CONFIG_LEGACY_PTY_COUNT=16
CONFIG_NEWHAVEN_LCD=y
CONFIG_SERIAL_8250=y
CONFIG_SERIAL_8250_CONSOLE=y
CONFIG_SERIAL_8250_NR_UARTS=7
CONFIG_SERIAL_8250_RUNTIME_UARTS=7
CONFIG_SERIAL_8250_DW=y
CONFIG_HW_RANDOM=y
CONFIG_I2C=y
CONFIG_I2C_CHARDEV=y
CONFIG_I2C_DESIGNWARE_PLATFORM=y
CONFIG_SPI=y
CONFIG_SPI_CADENCE_QSPI=y
CONFIG_SPI_DESIGNWARE=y
CONFIG_SPI_DW_PL330_DMA=y
CONFIG_SPI_DW_MMIO=y
CONFIG_SPI_SPIDEV=y
CONFIG_GPIOLIB=y
CONFIG_GPIO_SYSFS=y
CONFIG_GPIO_DWAPB=y
CONFIG_GPIO_ALTERA=y
CONFIG_SENSORS_LM73=y
CONFIG_WATCHDOG=y
CONFIG_DW_WATCHDOG=y
CONFIG_FB=y
CONFIG_FB_ALTERA_VIP=y
CONFIG_USB=y
CONFIG_USB_ANNOUNCE_NEW_DEVICES=y
CONFIG_USB_STORAGE=y
CONFIG_USB_DWC2=y
CONFIG_NOP_USB_XCEIV=y
CONFIG_USB_ULPI=y
CONFIG_USB_GADGET=y
CONFIG_USB_ETH=m
CONFIG_USB_MASS_STORAGE=m
CONFIG_MMC=y
CONFIG_MMC_DW=y
CONFIG_MMC_DW_IDMAC=y
CONFIG_NEW_LEDS=y
CONFIG_LEDS_CLASS=y
CONFIG_LEDS_GPIO=y
CONFIG_LEDS_LP5562=y
CONFIG_LEDS_TRIGGERS=y
CONFIG_LEDS_TRIGGER_TIMER=y
CONFIG_LEDS_TRIGGER_CPU=y
CONFIG_RTC_CLASS=y
# CONFIG_RTC_HCTOSYS is not set
CONFIG_RTC_DRV_AB18XX=y
CONFIG_DMADEVICES=y
CONFIG_PL330_DMA=y
CONFIG_UIO=y
CONFIG_UIO_PDRV_GENIRQ=m
CONFIG_UIO_DMEM_GENIRQ=y
CONFIG_STAGING=y
CONFIG_GENERIC_PHY=y
CONFIG_EXT2_FS=y
CONFIG_EXT2_FS_XATTR=y
CONFIG_EXT2_FS_POSIX_ACL=y
CONFIG_EXT3_FS=y
CONFIG_EXT4_FS=y
# CONFIG_DNOTIFY is not set
CONFIG_VFAT_FS=y
CONFIG_NTFS_FS=y
CONFIG_NTFS_RW=y
CONFIG_TMPFS=y
CONFIG_JFFS2_FS=y
CONFIG_NFS_FS=y
CONFIG_NFS_V4=y
CONFIG_ROOT_NFS=y
CONFIG_NLS_CODEPAGE_437=y
CONFIG_NLS_ISO8859_1=y
CONFIG_DEBUG_INFO=y
CONFIG_MAGIC_SYSRQ=y
CONFIG_DETECT_HUNG_TASK=y
# CONFIG_SCHED_DEBUG is not set
CONFIG_FUNCTION_TRACER=y
CONFIG_DEBUG_USER=y
# CONFIG_XZ_DEC_X86 is not set
# CONFIG_XZ_DEC_POWERPC is not set
# CONFIG_XZ_DEC_IA64 is not set
# CONFIG_XZ_DEC_SPARC is not set
```

## drivers/pci/host/Kconfig
```kconfig
menu "PCI host controller drivers"
	depends on PCI

config PCI_MVEBU
	bool "Marvell EBU PCIe controller"
	depends on ARCH_MVEBU || ARCH_DOVE || ARCH_KIRKWOOD
	depends on OF

config PCIE_DW
	bool

config PCI_EXYNOS
	bool "Samsung Exynos PCIe controller"
	depends on SOC_EXYNOS5440
	select PCIEPORTBUS
	select PCIE_DW

config PCI_IMX6
	bool "Freescale i.MX6 PCIe controller"
	depends on SOC_IMX6Q
	select PCIEPORTBUS
	select PCIE_DW

config PCI_TEGRA
	bool "NVIDIA Tegra PCIe controller"
	depends on ARCH_TEGRA

config PCI_RCAR_GEN2
	bool "Renesas R-Car Gen2 Internal PCI controller"
	depends on ARM && (ARCH_R8A7790 || ARCH_R8A7791 || COMPILE_TEST)
	help
	  Say Y here if you want internal PCI support on R-Car Gen2 SoC.
	  There are 3 internal PCI controllers available with a single
	  built-in EHCI/OHCI host controller present on each one.

config PCI_ALTERA
	bool "Altera PCIe controller"
	depends on ARCH_SOCFPGA
	help
	  The Altera PCIe Root Port driver.

config PCI_ALTERA_MSI
	bool "Altera MSI-to-GIC support"
	depends on PCI_MSI && PCI_ALTERA
	help
	  This selects support for Altera MSI to GIC controller IP. Select
	  this option if the IP is present on system.

endmenu
```

## drivers/staging/aclsoc/Kconfig
```kconfig
#
# "Altera Cyclone V SOC OpenCL Driver"
#
config ACLSOC
	tristate "Altera Open CL Driver for Cyclone V SOC module"
	default n
	help
	  Altera Open CL Driver for Cyclone V SOC module
```
