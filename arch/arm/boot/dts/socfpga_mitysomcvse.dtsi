#include "socfpga_mitysom5cs.dtsi"

/{
	memory {
		name = "memory";
		device_type = "memory";
		reg = <0x0 0x20000000>; /* 512 MB  */
	};

	soc {
		qspi: spi@ff705000 {
			status = "disabled";
		};
	};
};
